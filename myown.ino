// O2 Minipops rhythm box (c) DSP Synthesizers 2016
// Free for non commercial use

// http://janostman.wordpress.com


#include <avr/interrupt.h>
#include <avr/io.h>
#include <avr/pgmspace.h>


#ifndef cbi
#define cbi(sfr, bit) (_SFR_BYTE(sfr) &= ~_BV(bit))
#endif
#ifndef sbi
#define sbi(sfr, bit) (_SFR_BYTE(sfr) |= _BV(bit))
#endif 

// Standard Arduino Pins
#define digitalPinToPortReg(P) \
(((P) >= 0 && (P) <= 7) ? &PORTD : (((P) >= 8 && (P) <= 13) ? &PORTB : &PORTC))
#define digitalPinToDDRReg(P) \
(((P) >= 0 && (P) <= 7) ? &DDRD : (((P) >= 8 && (P) <= 13) ? &DDRB : &DDRC))
#define digitalPinToPINReg(P) \
(((P) >= 0 && (P) <= 7) ? &PIND : (((P) >= 8 && (P) <= 13) ? &PINB : &PINC))
#define digitalPinToBit(P) \
(((P) >= 0 && (P) <= 7) ? (P) : (((P) >= 8 && (P) <= 13) ? (P) - 8 : (P) - 14))

#define digitalReadFast(P) bitRead(*digitalPinToPINReg(P), digitalPinToBit(P))
                  
#define digitalWriteFast(P, V) bitWrite(*digitalPinToPortReg(P), digitalPinToBit(P), (V))

const unsigned char PS_128 = (1 << ADPS2) | (1 << ADPS1) | (1 << ADPS0);




//--------- Ringbuf parameters ----------
uint8_t Ringbuffer[256];
uint8_t RingWrite=0;
uint8_t RingRead=0;
volatile uint8_t RingCount=0;
volatile uint16_t SFREQ;
//-----------------------------------------

//Patterns GU BG2 BD CL CW MA CY QU
/*
16 steps
------------
Hard rock
Disco
Reggae
Rock
Samba
Rumba
Cha-Cha
Swing
Bossa Nova
Beguine
Synthpop
12-steps
---------
Boogie
Waltz
Jazz rock
Slow rock
Oxygen
 */

const unsigned char patlen[16] PROGMEM = {15,15,15,15,15,15,15,15,15,15,15,11,11,11,11,11};

const unsigned char pattern[256] PROGMEM = {
  B00101100,      //Hard rock16
  B00000000,
  B00000100,
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  B00000000,
  B00000000

};
const unsigned char BD[1076] PROGMEM =
{
126,122,118,114,111,108,105,103,101,99,98,96,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147,
147,148,149,149,150,151,151,152,153,153,154,154,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155,
155,154,154,153,152,152,151,151,150,150,149,148,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96,
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127,127,127,127,126,126,126,127,127,127,127,127,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128,
}; 
const unsigned char BG2[1136] PROGMEM =
{
  128,122,108,96,86,80,78,79,82,89,98,108,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54,
  48,43,39,37,36,37,40,43,49,55,63,72,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70,
  65,61,57,55,54,54,55,58,61,66,71,77,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92,
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  129,129,128,128,128,128,127,127,127,127,127,126,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128,
};

const unsigned char CL[752] PROGMEM =
{
  125,82,65,93,135,172,181,161,118,74,48,54,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80,
  98,119,134,135,123,103,84,76,81,99,122,141,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96,
  96,101,111,120,124,122,116,108,102,102,109,120,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112,
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  126,126,126,127,127,127,128,128,129,129,129,129,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128,
};

const unsigned char CW[830] PROGMEM =
{
  155,223,121,59,131,200,124,42,93,189,170,83,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129,
  108,98,111,119,106,98,112,128,125,117,128,147,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109,
  114,116,117,121,129,134,135,138,143,147,145,143,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128,
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  130,130,130,129,129,129,128,128,128,127,127,127,127,127,127,127,127,128,128,128,128,128,128,128,128,128,128,128,128,128,128,128,128,128,
};

const unsigned char CY[1462] PROGMEM =
{
  63130,63129,2992,2994,61953,61951,4637,4640,59012,59009,43927,43928,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59226,
55268,55267,59509,59508,6701,6703,4092,4089,2349,2353,1149,1145,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839,
783,784,678,677,64081,64082,65105,65105,64564,64565,62189,62187,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843,
522,525,535,531,127,131,65400,65398,1206,1207,1156,1155,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59,
586,592,64943,64940,64739,64739,64856,64857,64854,64853,65367,65368,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65417,
65437,65436,65211,65212,308,309,77,73,224,231,65472,65463,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65508,

};

const unsigned char GU[2816] PROGMEM =
{
  129,128,128,128,128,129,127,125,60,183,220,111,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128,
  128,128,128,128,128,128,128,128,128,128,128,128,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128,
  128,128,128,128,128,128,128,128,128,128,128,128,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127,
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  128,128,128,128,128,128,128,128,128,128,128,128,128,128,128,128,128,128,128,128,
};


const unsigned char MA[568] PROGMEM =
{
  127,124,134,122,131,126,127,126,129,124,134,127,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142,
  121,116,140,122,125,132,134,124,129,128,110,145,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125,
  125,139,125,130,119,132,129,124,129,129,130,122,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125,
  136,124,129,129,126,129,128,127,129,129,128,125,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131,
  128,128,129,126,132,124,131,128,130,127,129,121,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127,
  129,130,126,127,129,127,129,130,125,129,127,129,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128,
};

const unsigned char QU[7712] PROGMEM =
{
  128,129,131,132,137,169,173,141,100,73,75,103,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129,
  129,128,128,127,127,128,128,128,129,128,128,128,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125,
  124,126,128,130,131,131,129,127,126,126,128,129,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128,
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  128,128,128,128,128,128,128,128,128,128,128,128,128,128,128,128,
};

ISR(TIMER1_COMPA_vect) {
  
    //-------------------  Ringbuffer handler -------------------------
    
    if (RingCount) {                            //If entry in FIFO..
      OCR2A = Ringbuffer[(RingRead++)];          //Output LSB of 16-bit DAC
      RingCount--;
    }
    
    //-----------------------------------------------------------------

}



void setup() {
  
    OSCCAL=0xFF;
    
    //Drum mute inputs
    pinMode(2,INPUT_PULLUP);
    pinMode(3,INPUT_PULLUP);
    pinMode(4,INPUT_PULLUP);
    pinMode(5,INPUT_PULLUP);
    pinMode(6,INPUT_PULLUP);
    pinMode(7,INPUT_PULLUP);
    pinMode(8,INPUT_PULLUP);
    pinMode(9,INPUT_PULLUP);

    pinMode(10,INPUT_PULLUP); //RUN - Stop input
    pinMode(12,OUTPUT);       //Reset output
    pinMode(13,OUTPUT);       //Clock output

    pinMode(14,OUTPUT);       //SEQ cnt output
    pinMode(15,OUTPUT); 
    pinMode(16,OUTPUT); 
    pinMode(17,OUTPUT); 
    
    //8-bit PWM DAC pin
    pinMode(11,OUTPUT);

    // Set up Timer 1 to send a sample every interrupt.
    cli();
    // Set CTC mode
    // Have to set OCR1A *after*, otherwise it gets reset to 0!
    TCCR1B = (TCCR1B & ~_BV(WGM13)) | _BV(WGM12);
    TCCR1A = TCCR1A & ~(_BV(WGM11) | _BV(WGM10));    
    // No prescaler
    TCCR1B = (TCCR1B & ~(_BV(CS12) | _BV(CS11))) | _BV(CS10);
    // Set the compare register (OCR1A).
    // OCR1A is a 16-bit register, so we have to do this with
    // interrupts disabled to be safe.
    //OCR1A = F_CPU / SAMPLE_RATE; 
    // Enable interrupt when TCNT1 == OCR1A
    TIMSK1 |= _BV(OCIE1A);   
    sei();
    OCR1A = 800; //40KHz Samplefreq

// Set up Timer 2 to do pulse width modulation on D11

    // Use internal clock (datasheet p.160)
    ASSR &= ~(_BV(EXCLK) | _BV(AS2));

    // Set fast PWM mode  (p.157)
    TCCR2A |= _BV(WGM21) | _BV(WGM20);
    TCCR2B &= ~_BV(WGM22);

    // Do non-inverting PWM on pin OC2A (p.155)
    // On the Arduino this is pin 11.
    TCCR2A = (TCCR2A | _BV(COM2A1)) & ~_BV(COM2A0);
    TCCR2A &= ~(_BV(COM2B1) | _BV(COM2B0));
    // No prescaler (p.158)
    TCCR2B = (TCCR2B & ~(_BV(CS12) | _BV(CS11))) | _BV(CS10);

    // Set initial pulse width to the first sample.
    OCR2A = 128;

    //set timer0 interrupt at 61Hz
    TCCR0A = 0;// set entire TCCR0A register to 0
    TCCR0B = 0;// same for TCCR0B
    TCNT0  = 0;//initialize counter value to 0
    // set compare match register for 62hz increments
    OCR0A = 255;// = 61Hz
    // turn on CTC mode
    TCCR0A |= (1 << WGM01);
    // Set CS01 and CS00 bits for prescaler 1024
    TCCR0B |= (1 << CS02) | (0 << CS01) | (1 << CS00);  //1024 prescaler 

    TIMSK0=0;


    // set up the ADC
    SFREQ=analogRead(0);
    ADCSRA &= ~PS_128;  // remove bits set by Arduino library
    // Choose prescaler PS_128.
    ADCSRA |= PS_128;
    ADMUX = 64;
    sbi(ADCSRA, ADSC);
         
}




void loop() {  

  uint16_t samplecntBD,samplecntBG2,samplecntCL,samplecntCW,samplecntCY,samplecntGU,samplecntMA,samplecntQU;

  samplecntBD=0;
  samplecntBG2=0;
  samplecntCL=0;
  samplecntCW=0;
  samplecntCY=0;
  samplecntGU=0;
  samplecntMA=0;
  samplecntQU=0;

  uint16_t samplepntBD,samplepntBG2,samplepntCL,samplepntCW,samplepntCY,samplepntGU,samplepntMA,samplepntQU;
  
  int16_t total;

  uint8_t stepcnt=0;
  uint16_t tempo=3500;
  uint16_t tempocnt=1;
  uint8_t MUX=4;

  uint8_t patselect=13;
  uint8_t patlength=pgm_read_byte_near(patlen + patselect);
  
  while(1) { 

    //------ Add current sample word to ringbuffer FIFO --------------------  
        
    if (RingCount<255) {  //if space in ringbuffer
      total=0;
      if (samplecntBD) {
        total+=(pgm_read_byte_near(BD + samplepntBD++)-128);
        samplecntBD--;
      }
      if (samplecntBG2) {
        total+=(pgm_read_byte_near(BG2 + samplepntBG2++)-128);
        samplecntBG2--;
      }
      if (samplecntCL) {
        total+=(pgm_read_byte_near(CL + samplepntCL++)-128);
        samplecntCL--;
      }
      if (samplecntCW) {
        total+=(pgm_read_byte_near(CW + samplepntCW++)-128);
        samplecntCW--;
      }
      if (samplecntCY) {
        total+=(pgm_read_byte_near(CY + samplepntCY++)-128);
        samplecntCY--;
      }
      if (samplecntGU) {
        total+=(pgm_read_byte_near(GU + samplepntGU++)-128);
        samplecntGU--;
      }
       if (samplecntMA) {
        total+=(pgm_read_byte_near(MA + samplepntMA++)-128);
        samplecntMA--;
      }
      if (samplecntQU) {
        total+=(pgm_read_byte_near(QU + samplepntQU++)-128);
        samplecntQU--;
      }
      if (total<-127) total=-127;
      if (total>127) total=127;                           
      cli();
      Ringbuffer[RingWrite]=total+128;
      RingWrite++;
      RingCount++;
      sei();
 

//----------------------------------------------------------------------------

//--------- sequencer block ----------------------------------------------
if (digitalReadFast(10)) {
  if (!(tempocnt--)) {
    tempocnt=tempo;
    digitalWriteFast(13,HIGH); //Clock out Hi
    uint8_t trig=pgm_read_byte_near(pattern + (patselect<<4) + stepcnt++);
    PORTC=stepcnt;
    uint8_t mask=(PIND>>2)|((PINB&3)<<6);
    trig&=mask;
    if (stepcnt>patlength) stepcnt=0;
    if (stepcnt==0) digitalWriteFast(12,HIGH); //Reset out Hi
    if (stepcnt!=0) digitalWriteFast(12,LOW); //Reset out Lo
    if (trig & 1) {
      samplepntQU=0;
      samplecntQU=7712;
    }
    if (trig & 2) {
      samplepntCY=0;
      samplecntCY=9434;
    }
    if (trig & 4) {
      samplepntMA=0;
      samplecntMA=568;
    }
    if (trig & 8) {
      samplepntCW=0;
      samplecntCW=830;
    }
    if (trig & 16) {
      samplepntCL=0;
      samplecntCL=752;
    }
    if (trig & 32) {
      samplepntBD=0;
      samplecntBD=1076;
    }
    if (trig & 64) {
      samplepntBG2=0;
      samplecntBG2=1136;
    }
    if (trig & 128) {
      samplepntGU=0;
      samplecntGU=2816;
    }
  }
  digitalWriteFast(13,LOW); //Clock out Lo
 }
}
if (!(digitalReadFast(10))) {
  digitalWriteFast(13,LOW); //Clock out Lo
  digitalWriteFast(12,LOW); //Reset out Lo
  PORTC=0;
  stepcnt=0;
  tempocnt=1
;}
//------------------------------------------------------------------------



//--------------- ADC block -------------------------------------
    if (!(ADCSRA & 64)) {

      uint16_t value=((ADCL+(ADCH<<8))>>3)+1;
      if (MUX==5) tempo=(value<<8)+1250;  //17633-1250
      if (MUX==4) patselect=(value-1)>>3;
      if (MUX==4) patlength=pgm_read_byte_near(patlen + patselect);
      
      MUX++;
      if (MUX==8) MUX=4;
      ADMUX = 64 | MUX; //Select MUX
      sbi(ADCSRA, ADSC); //start next conversation
    };
//---------------------------------------------------------------
    
  }
 
}

